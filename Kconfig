## Kconfig
```kconfig
# SPDX-License-Identifier: GPL-2.0-only

menu "cdk2 payload"

config CDK2_PAYLOAD
	bool "Build the cdk2 coreboot payload"
	default y
	help
	  Select the payload composition used by the private cdk2 fork.
	  coreboot remains the owner of platform policy; this option only
	  describes the payload build consumed by coreboot.

config CDK2_PCI
	bool "Include PCI support"
	default y
	depends on CDK2_PAYLOAD

config CDK2_STORAGE
	bool "Include storage support"
	default y
	depends on CDK2_PCI

config CDK2_CONSOLE
	bool "Include console support"
	default y
	depends on CDK2_PAYLOAD

config CDK2_GRAPHICS
	bool "Include graphics support"
	default y
	depends on CDK2_CONSOLE && CDK2_PCI

config CDK2_GOP_HIDPI
	bool "Enable high-DPI GOP scaling"
	default n
	depends on CDK2_GRAPHICS
	help
	  Expose a 2x scaled GOP mode for high-DPI framebuffers handed off by
	  coreboot.

config CDK2_GOP_HIDPI_H_THRESHOLD
	int "High-DPI GOP horizontal threshold"
	default 1920
	depends on CDK2_GOP_HIDPI

config CDK2_GOP_HIDPI_V_THRESHOLD
	int "High-DPI GOP vertical threshold"
	default 1080
	depends on CDK2_GOP_HIDPI

config CDK2_GOP_HIDPI_ASPECT_CAP
	bool "Cap wide high-DPI GOP viewports"
	default n
	depends on CDK2_GOP_HIDPI
	help
	  Center the scaled GOP viewport inside framebuffers wider than the
	  configured aspect ratio.

config CDK2_GOP_HIDPI_ASPECT_W
	int "High-DPI GOP aspect width"
	default 16
	depends on CDK2_GOP_HIDPI_ASPECT_CAP

config CDK2_GOP_HIDPI_ASPECT_H
	int "High-DPI GOP aspect height"
	default 9
	depends on CDK2_GOP_HIDPI_ASPECT_CAP

config CDK2_SETUP_UI
	bool "Include the firmware setup UI"
	default y
	depends on CDK2_CONSOLE
	help
	  Include the CFR, UiApp, setup browser, and boot-manager UI modules.
	  Disable this only for payloads that provide their own setup surface.

config CDK2_LVGL_RENDERER
	bool "Use the LVGL graphical setup renderer"
	default n
	depends on CDK2_SETUP_UI
	help
	  Render the firmware setup and boot menu with the LVGL renderer.

config CDK2_CONNECT_ALL_DEVICES
	bool "Connect every device before boot"
	default n
	depends on CDK2_PAYLOAD
	help
	  Connect all boot-service devices before selecting a boot option. The
	  default selective policy connects the chosen internal path and falls
	  back to removable media discovery only when needed.

config CDK2_LINUX_EFI_APPLICATION
	bool "Register a Linux EFI application boot option"
	default n
	depends on CDK2_STORAGE
	help
	  Register a Boot#### option for a Linux kernel built as a UEFI
	  application. The image is checked for a valid EFI application header,
	  then probed with EFI LoadImage() before the option is added so firmware
	  image policy is applied. If the image is absent, not an EFI application,
	  or rejected by policy, cdk2 leaves the normal boot order unchanged.

	  If a TCG or TCG2 measured-boot protocol is present, cdk2 leaves the normal
	  boot order unchanged because probing firmware image policy would measure
	  the candidate before it is actually selected for boot.

config CDK2_LINUX_EFI_APPLICATION_PATH
	string "Linux EFI application path"
	default "\\EFI\\Linux\\vmlinuz.efi"
	depends on CDK2_LINUX_EFI_APPLICATION
	help
	  Absolute path on the EFI system partition. Use UEFI backslashes, not
	  shell-style forward slashes or an FS0: prefix.

config CDK2_LINUX_EFI_APPLICATION_DESCRIPTION
	string "Linux EFI application boot description"
	default "Linux EFI Application"
	depends on CDK2_LINUX_EFI_APPLICATION
	help
	  Description stored in the generated Boot#### option.

config CDK2_ESRT
	bool "Include ESRT support"
	default y
	depends on CDK2_PAYLOAD

config CDK2_LATE_LINK
	bool "Use cdk2 late-link policy"
	default y
	depends on CDK2_PAYLOAD
	help
	  Apply cdk2's final PE/COFF linker alignment policy to every payload
	  image. This is intentionally selected by the payload build rather than
	  inherited from a platform default.

config CDK2_NATIVE_STAGE
	bool "Build the native cdk2 stage"
	default y
	depends on CDK2_PAYLOAD
	help
	  Build the freestanding C/linker stage used by the direct coreboot
	  handoff. The native stage owns HOB construction and the coreboot entry
	  flow.

config CDK2_NATIVE_SECURITY_STUB
	bool "Build the native Security architectural protocol stub"
	default y
	depends on CDK2_NATIVE_STAGE
	help
	  Build SecurityStubDxe from CDK2-owned source for deterministic
	  replacement in the retained migration firmware volume.

config CDK2_NULL_MEMORY_TEST
	bool "Build the native null memory-test driver"
	default y
	depends on CDK2_PAYLOAD
	help
	  Install the Generic Memory Test Protocol and promote initialized coreboot
	  memory without running a destructive firmware memory test.

config CDK2_NATIVE_ENGLISH
	bool "Build the native English Unicode collation driver"
	default y
	depends on CDK2_NATIVE_STAGE
	help
	  Provide the English Unicode Collation 2 protocol and FAT filename
	  conversion from CDK2-owned source.

config CDK2_NATIVE_WATCHDOG
	bool "Build the native UEFI watchdog driver"
	default y
	depends on CDK2_NATIVE_STAGE
	help
	  Replace the retained WatchdogTimerDxe file with CDK2's source-built
	  architectural watchdog protocol driver.

config CDK2_NATIVE_MONOTONIC_COUNTER
	bool "Build native monotonic-counter services"
	default y
	depends on CDK2_NATIVE_STAGE

config CDK2_NATIVE_STATUS_CODE_ROUTER
	bool "Build the native report-status-code router"
	default y
	depends on CDK2_NATIVE_STAGE
	help
	  Build the runtime status-code and handler protocols used by native
	  diagnostic consumers.

config CDK2_NATIVE_CPU_IO2
	bool "Build native CPU I/O 2 services"
	default y
	depends on CDK2_NATIVE_STAGE
	help
	  Replace CpuIo2Dxe with CDK2-owned MMIO and x86 port-I/O services.

config CDK2_NATIVE_STATUS_CODE_HANDLER
	bool "Build the native release status-code handler"
	default y
	depends on CDK2_NATIVE_STATUS_CODE_ROUTER && !CDK2_BUILD_DEBUG
	help
	  Replace the release-profile handler, whose admitted configuration has
	  serial and memory sinks disabled. Debug builds retain their configured
	  handler until native diagnostic sinks are available.

config CDK2_NATIVE_DISK_IO
	bool "Build native Disk I/O services"
	default y
	depends on CDK2_NATIVE_STAGE && CDK2_STORAGE
	help
	  Provide Disk I/O and Disk I/O 2 on Block I/O controllers. Version 2
	  requests use the standard completion token with a blocking backend.

config CDK2_NATIVE_SERIAL_IO
	bool "Build native serial I/O services"
	default y
	depends on CDK2_NATIVE_STAGE
	help
	  Publish the PI Serial I/O protocol over the UART described by the
	  coreboot-derived serial-port HOB.

config CDK2_SMBIOS_MAJOR
	int "SMBIOS major version"
	range 2 3
	default 3
	depends on CDK2_PAYLOAD

config CDK2_SMBIOS_MINOR
	int "SMBIOS minor version"
	range 0 9
	default 0
	depends on CDK2_PAYLOAD

config CDK2_SMBIOS_DOCREV
	int "SMBIOS document revision"
	range 0 255
	default 0
	depends on CDK2_PAYLOAD

config CDK2_SMBIOS_ENTRY_POINTS
	hex "SMBIOS entry-point publication mask"
	range 0x1 0x3
	default 0x3
	depends on CDK2_PAYLOAD
	help
	  Bit 0 publishes the SMBIOS 2.x entry point; bit 1 publishes SMBIOS 3.x.

config CDK2_NATIVE_SMBIOS
	bool "Build native SMBIOS services"
	default y
	depends on CDK2_NATIVE_STAGE
	help
	  Import the coreboot SMBIOS HOB, provide the mutable PI SMBIOS protocol,
	  and publish checksummed SMBIOS 2.x and 3.x configuration tables.

config CDK2_NATIVE_RESET_SYSTEM
	bool "Build native reset-system services"
	default y
	depends on CDK2_NATIVE_STAGE
	help
	  Publish the architectural and notification reset protocols and implement
	  ResetSystem from the coreboot-derived ACPI board-information HOB.

config CDK2_NATIVE_PCAT_RTC
	bool "Build native PC/AT real-time-clock services"
	default y
	depends on CDK2_NATIVE_STAGE
	help
	  Publish the real-time-clock architectural protocol and provide runtime
	  time and wake-alarm services through the PC/AT CMOS register interface.

config CDK2_NATIVE_SMM_ACCESS
	bool "Build native SMM Access 2 services"
	default y
	depends on CDK2_NATIVE_STAGE && CDK2_SMM
	help
	  Publish the SMM Access 2 protocol from the SMRAM descriptor supplied by
	  coreboot and translated into the PI SMRAM GUID HOB.

config CDK2_NATIVE_SMM_CONTROL
	bool "Build native SMM Control 2 services"
	default y
	depends on CDK2_NATIVE_STAGE && CDK2_SMM
	help
	  Publish the runtime SMM Control 2 protocol from the authoritative SMI
	  register description supplied by coreboot.

config CDK2_NATIVE_CPU_IO2_SMM
	bool "Build native SMM CPU I/O 2 services"
	default y
	depends on CDK2_NATIVE_STAGE && CDK2_SMM
	help
	  Publish the SMM CPU I/O 2 protocol and populate the management-mode
	  system table with native MMIO and port-I/O services.

config CDK2_BUILD_DEBUG
	bool "Build a debug payload"
	default n
	depends on CDK2_PAYLOAD
	help
	  Enable serial/debug output. Release builds are the default for
	  production payloads and for comparable QEMU runs.

config CDK2_SMMSTORE
	bool "Use coreboot SMMSTORE variables"
	default y
	depends on CDK2_SMM
	help
	  Use the coreboot SMMSTORE implementation. The payload must not provide a
	  second variable-store implementation.

config CDK2_EC_ACPI_BATTERY_PROFILE
	int "EC ACPI battery profile"
	range 0 4
	default 0
	depends on CDK2_PAYLOAD
	help
	  Select the EC battery status profile consumed by the cdk2 ACPI battery
	  status driver. coreboot board Kconfig owns the value for integrated
	  builds.

config CDK2_CAPSULE
	bool "Include capsule update support"
	default n
	depends on CDK2_SMM && CDK2_ESRT && CDK2_GRAPHICS

config CDK2_CAPSULE_MAIN_FW_GUID
	string "Capsule system firmware FMP GUID"
	default ""
	depends on CDK2_CAPSULE
	help
	  GUID assigned to the FmpDxe instance used for system firmware capsules.
	  Required when capsule update support is enabled.

config CDK2_CAPSULE_ON_DISK_SUPPORT
	bool "Support capsules on disk"
	default n
	depends on CDK2_CAPSULE
	help
	  Permit update capsules to be submitted via the EFI system partition.

config CDK2_CAPSULE_ACCEPT_EMBEDDED_DRIVERS
	bool "Allow embedded drivers in update capsules"
	default n
	depends on CDK2_CAPSULE
	help
	  Permit FMP capsules to carry embedded DXE drivers.

config CDK2_CAPSULE_EMBED_FMP_DXE
	bool "Embed FmpDxe in generated capsules"
	default n
	depends on CDK2_CAPSULE
	select CDK2_CAPSULE_ACCEPT_EMBEDDED_DRIVERS
	help
	  Embed the FmpDxe driver in generated update capsules instead of keeping
	  it in the payload FV.

config CDK2_SECURE_BOOT
	bool "Enable secure boot support"
	default n
	depends on CDK2_PAYLOAD
	select CDK2_ESRT

config CDK2_SECURE_BOOT_CONFIG
	bool "Include secure boot configuration UI"
	default y
	depends on CDK2_SECURE_BOOT && CDK2_SETUP_UI

config CDK2_SECURE_BOOT_ASSUME_SETUP_PHYSICAL_PRESENCE
	bool "Treat setup as Secure Boot physical presence"
	default n
	depends on CDK2_SECURE_BOOT_CONFIG && !CDK2_EVIL_MAID_PROTECTION
	help
	  Permit firmware setup to satisfy authenticated-variable physical
	  presence checks. This is useful for development and recovery-oriented
	  builds, but production anti-tamper builds should leave it disabled.

config CDK2_EVIL_MAID_PROTECTION
	bool "Enable TPM-backed anti-tamper boot policy"
	default n
	depends on CDK2_SECURE_BOOT && CDK2_TPM2 && CDK2_SMMSTORE
	depends on !CDK2_TPM12 && !CDK2_SHELL
	help
	  Require a locked Secure Boot variable state and a usable TPM2 measurement
	  path before boot options are launched. The runtime gate is intended for
	  HEADS-inspired builds where a machine should fail closed when firmware
	  policy or TPM presence cannot be verified.

config CDK2_EVIL_MAID_REQUIRE_TPM_PPI
	bool "Require TPM physical-presence interface handoff"
	default y
	depends on CDK2_EVIL_MAID_PROTECTION
	help
	  Require coreboot to pass a TPM2 physical-presence interface HOB. This
	  keeps destructive TPM/update operations tied to a platform-owned physical
	  presence path. Disable only for bring-up targets without TPM PPI plumbing.

config CDK2_EVIL_MAID_SHUTDOWN_ON_FAILURE
	bool "Shut down on anti-tamper boot policy failure"
	default y
	depends on CDK2_EVIL_MAID_PROTECTION
	help
	  Shut the system down instead of dropping into an indefinite firmware loop
	  when the anti-tamper gate rejects the boot.

config CDK2_SMM
	bool "Include SMM payload modules"
	default y
	depends on CDK2_PAYLOAD

config CDK2_SHELL
	bool "Include the UEFI shell"
	default y
	depends on CDK2_PAYLOAD

config CDK2_NVME
	bool "Include NVMe support"
	default y
	depends on CDK2_PCI && CDK2_STORAGE

config CDK2_USB
	bool "Include USB support"
	default y
	depends on CDK2_PCI

config CDK2_ATA
	bool "Include ATA support"
	default y
	depends on CDK2_PCI && CDK2_STORAGE

config CDK2_SD
	bool "Include SD support"
	default y
	depends on CDK2_PCI && CDK2_STORAGE

config CDK2_PS2_MOUSE
	bool "Include PS/2 mouse support"
	default y
	depends on CDK2_CONSOLE && CDK2_PCI
	select CDK2_SIO_BUS

config CDK2_SIO_BUS
	bool
	depends on CDK2_PCI

config CDK2_PS2_KEYBOARD
	bool "Include PS/2 keyboard support"
	default n
	depends on CDK2_CONSOLE && CDK2_PCI
	select CDK2_SIO_BUS

config CDK2_SERIAL
	bool "Enable the serial driver"
	default n
	depends on CDK2_CONSOLE

config CDK2_CBMEM_CONSOLE
	bool "Use the coreboot cbmem console"
	default n
	depends on CDK2_SERIAL

config CDK2_CBMEM_TIMESTAMPS
	bool "Publish payload timestamps through CBMEM"
	default n
	depends on CDK2_PAYLOAD
	help
	  Record cdk2 entry, HOB, DXE load, and handoff timestamps in the
	  coreboot CBMEM timestamp table.

config CDK2_BOOT_TIMEOUT
	int "Default boot menu timeout in seconds"
	range 0 60
	default 0
	depends on CDK2_PAYLOAD

config CDK2_TPM12
	bool "Include TPM 1.2 support"
	default y
	depends on CDK2_PAYLOAD

config CDK2_TPM2
	bool "Include TPM 2 support"
	default y
	depends on CDK2_PAYLOAD

config CDK2_TPM_CONFIG
	bool "Include TPM configuration UI"
	default y
	depends on (CDK2_TPM12 || CDK2_TPM2) && CDK2_SETUP_UI

config CDK2_CPU_TIMER
	bool "Use CPUID leaf 0x15 for the CPU timer"
	default n
	depends on CDK2_PAYLOAD
	help
	  QEMU does not provide the timer contract required by this library.

config CDK2_MAX_LOGICAL_PROCESSORS
	int "Maximum logical processors"
	range 1 4096
	default 1024
	depends on CDK2_PAYLOAD
	help
	  Upper bound for the UEFI CPU driver processor table. coreboot board
	  Kconfig should pass the platform CONFIG_MAX_CPUS value.

choice
	prompt "UEFI timer driver"
	default CDK2_LAPIC_TIMER
	depends on CDK2_PAYLOAD
	help
	  Select the timer architectural protocol installed by the payload.
	  Local APIC is the direct-coreboot default; HPET remains available for
	  platforms that explicitly provide a working HPET interrupt path.

config CDK2_LAPIC_TIMER
	bool "Local APIC timer"

config CDK2_HPET_TIMER
	bool "HPET timer"

endchoice

endmenu
```
