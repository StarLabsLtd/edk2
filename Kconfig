## UefiPayloadPkg/cdk2/Kconfig
```kconfig
## SPDX-License-Identifier: BSD-2-Clause-Patent

menu "cdk2 payload"

config CDK2_PAYLOAD
    bool "Build the cdk2 coreboot payload"
    default y
    help
      Select the payload composition used by the private cdk2 fork.
      Coreboot remains the owner of platform policy; this option only
      describes the payload build consumed by coreboot.

config CDK2_PCI
    bool "Include PCI support"
    default y
    depends on CDK2_PAYLOAD

config CDK2_STORAGE
    bool "Include storage support"
    default y
    depends on CDK2_PCI

config CDK2_CONSOLE
    bool "Include console support"
    default y
    depends on CDK2_PAYLOAD

config CDK2_GRAPHICS
    bool "Include graphics support"
    default y
    depends on CDK2_CONSOLE && CDK2_PCI

config CDK2_SETUP_UI
    bool "Include the firmware setup UI"
    default y
    depends on CDK2_CONSOLE
    help
      Include the CFR, UiApp, setup browser, and boot-manager UI modules.
      Disable this only for payloads that provide their own setup surface.

config CDK2_CONNECT_ALL_DEVICES
    bool "Connect every device before boot"
    default n
    depends on CDK2_PAYLOAD
    help
      Connect all boot-service devices before selecting a boot option. The
      default selective policy connects the chosen internal path and falls
      back to removable media discovery only when needed.

config CDK2_ESRT
    bool "Include ESRT support"
    default y
    depends on CDK2_PAYLOAD

config CDK2_LATE_LINK
    bool "Use cdk2 late-link policy"
    default y
    depends on CDK2_PAYLOAD
    help
      Apply cdk2's final PE/COFF linker alignment policy to every payload
      image. This is intentionally selected by the payload build rather than
      inherited from a platform default.

config CDK2_NATIVE_STAGE
    bool "Build the native cdk2 stage"
    default y
    depends on CDK2_PAYLOAD
    help
      Build the freestanding C/linker stage used by the direct coreboot
      handoff. The native stage owns HOB construction, DXE loading, and the
      coreboot image link; the EDK II backend may still produce the payload FV.

config CDK2_BUILD_DEBUG
    bool "Build a debug payload"
    default n
    depends on CDK2_PAYLOAD
    help
      Enable serial/debug output. Release builds are the default for
      production payloads and for comparable QEMU runs.

config CDK2_SMMSTORE
    bool "Use coreboot SMMSTORE variables"
    default y
    depends on CDK2_SMM
    help
      Use the coreboot SMMSTORE backend. The payload must not provide a
      second variable-store implementation.

config CDK2_CAPSULE
    bool "Include capsule update support"
    default n
    depends on CDK2_SMM && CDK2_ESRT && CDK2_GRAPHICS

config CDK2_CAPSULE_MAIN_FW_GUID
    string "Capsule system firmware FMP GUID"
    default ""
    depends on CDK2_CAPSULE
    help
      GUID assigned to the FmpDxe instance used for system firmware capsules.
      Required when capsule update support is enabled.

config CDK2_SECURE_BOOT
    bool "Enable secure boot support"
    default n
    depends on CDK2_PAYLOAD
    select CDK2_ESRT

config CDK2_SECURE_BOOT_CONFIG
    bool "Include secure boot configuration UI"
    default y
    depends on CDK2_SECURE_BOOT && CDK2_SETUP_UI

config CDK2_SECURE_BOOT_ASSUME_SETUP_PHYSICAL_PRESENCE
    bool "Treat setup as Secure Boot physical presence"
    default n
    depends on CDK2_SECURE_BOOT_CONFIG && !CDK2_EVIL_MAID_PROTECTION
    help
      Permit firmware setup to satisfy authenticated-variable physical
      presence checks. This is useful for development and recovery-oriented
      builds, but production anti-tamper builds should leave it disabled.

config CDK2_EVIL_MAID_PROTECTION
    bool "Enable TPM-backed anti-tamper boot policy"
    default n
    depends on CDK2_SECURE_BOOT && CDK2_TPM2 && CDK2_SMMSTORE
    help
      Require a locked Secure Boot variable state and a usable TPM2 measurement
      path before boot options are launched. The runtime gate is intended for
      HEADS-inspired builds where a machine should fail closed when firmware
      policy or TPM presence cannot be verified.

config CDK2_EVIL_MAID_REQUIRE_TPM_PPI
    bool "Require TPM physical-presence interface handoff"
    default y
    depends on CDK2_EVIL_MAID_PROTECTION
    help
      Require coreboot to pass a TPM2 physical-presence interface HOB. This
      keeps destructive TPM/update operations tied to a platform-owned physical
      presence path. Disable only for bring-up targets without TPM PPI plumbing.

config CDK2_EVIL_MAID_SHUTDOWN_ON_FAILURE
    bool "Shut down on anti-tamper boot policy failure"
    default y
    depends on CDK2_EVIL_MAID_PROTECTION
    help
      Shut the system down instead of dropping into an indefinite firmware loop
      when the anti-tamper gate rejects the boot.

config CDK2_SMM
    bool "Include SMM payload modules"
    default y
    depends on CDK2_PAYLOAD

config CDK2_SHELL
    bool "Include the UEFI shell"
    default y
    depends on CDK2_PAYLOAD

config CDK2_NVME
    bool "Include NVMe support"
    default y
    depends on CDK2_PCI && CDK2_STORAGE

config CDK2_USB
    bool "Include USB support"
    default y
    depends on CDK2_PCI

config CDK2_ATA
    bool "Include ATA support"
    default y
    depends on CDK2_PCI && CDK2_STORAGE

config CDK2_SD
    bool "Include SD support"
    default y
    depends on CDK2_PCI && CDK2_STORAGE

config CDK2_PS2_MOUSE
    bool "Include PS/2 mouse support"
    default y
    depends on CDK2_CONSOLE && CDK2_PCI
    select CDK2_SIO_BUS

config CDK2_SIO_BUS
    bool
    depends on CDK2_PCI

config CDK2_PS2_KEYBOARD
    bool "Include PS/2 keyboard support"
    default n
    depends on CDK2_CONSOLE && CDK2_PCI
    select CDK2_SIO_BUS

config CDK2_SERIAL
    bool "Enable the serial driver"
    default n
    depends on CDK2_CONSOLE

config CDK2_CBMEM_CONSOLE
    bool "Use the coreboot cbmem console"
    default n
    depends on CDK2_SERIAL

config CDK2_CBMEM_TIMESTAMPS
    bool "Publish payload timestamps through CBMEM"
    default n
    depends on CDK2_PAYLOAD
    help
      Record cdk2 entry, HOB, DXE load, and handoff timestamps in the
      coreboot CBMEM timestamp table.

config CDK2_BOOT_TIMEOUT
    int "Default boot menu timeout in seconds"
    range 0 60
    default 0
    depends on CDK2_PAYLOAD

config CDK2_TPM12
    bool "Include TPM 1.2 support"
    default y
    depends on CDK2_PAYLOAD

config CDK2_TPM2
    bool "Include TPM 2 support"
    default y
    depends on CDK2_PAYLOAD

config CDK2_TPM_CONFIG
    bool "Include TPM configuration UI"
    default y
    depends on (CDK2_TPM12 || CDK2_TPM2) && CDK2_SETUP_UI

config CDK2_CPU_TIMER
    bool "Use CPUID leaf 0x15 for the CPU timer"
    default n
    depends on CDK2_PAYLOAD
    help
      QEMU does not provide the timer contract required by this library.

choice
    prompt "UEFI timer driver"
    default CDK2_LAPIC_TIMER
    depends on CDK2_PAYLOAD
    help
      Select the timer architectural protocol installed by the payload.
      Local APIC is the direct-coreboot default; HPET remains available for
      platforms that explicitly provide a working HPET interrupt path.

config CDK2_LAPIC_TIMER
    bool "Local APIC timer"

config CDK2_HPET_TIMER
    bool "HPET timer"

endchoice

endmenu
```

## UefiPayloadPkg/cdk2/defconfig
```kconfig
CONFIG_CDK2_PAYLOAD=y
CONFIG_CDK2_PCI=y
CONFIG_CDK2_STORAGE=y
CONFIG_CDK2_CONSOLE=y
CONFIG_CDK2_GRAPHICS=y
# CONFIG_CDK2_SETUP_UI is not set
CONFIG_CDK2_LVGL=n
CONFIG_CDK2_ESRT=y
CONFIG_CDK2_LATE_LINK=y
CONFIG_CDK2_NATIVE_STAGE=y
CONFIG_CDK2_BUILD_DEBUG=n
CONFIG_CDK2_SMMSTORE=y
CONFIG_CDK2_SMM=y
CONFIG_CDK2_CAPSULE=n
CONFIG_CDK2_SECURE_BOOT=n
CONFIG_CDK2_SHELL=y
CONFIG_CDK2_NVME=y
CONFIG_CDK2_USB=y
CONFIG_CDK2_ATA=y
CONFIG_CDK2_SD=y
CONFIG_CDK2_PS2_MOUSE=y
CONFIG_CDK2_PS2_KEYBOARD=n
CONFIG_CDK2_SERIAL=n
CONFIG_CDK2_CBMEM_CONSOLE=n
CONFIG_CDK2_CBMEM_TIMESTAMPS=n
CONFIG_CDK2_BOOT_TIMEOUT=0
CONFIG_CDK2_TPM12=y
CONFIG_CDK2_TPM2=y
CONFIG_CDK2_CPU_TIMER=n
```

## UefiPayloadPkg/cdk2/q35-linux-efi.defconfig
```kconfig
## SPDX-License-Identifier: BSD-2-Clause-Patent

CONFIG_CDK2_PAYLOAD=y
CONFIG_CDK2_CONNECT_ALL_DEVICES=y
CONFIG_CDK2_LINUX_EFI_APPLICATION=y
CONFIG_CDK2_LINUX_EFI_APPLICATION_PATH="\\EFI\\Linux\\bzImage.efi"
CONFIG_CDK2_LINUX_EFI_APPLICATION_DESCRIPTION="Q35 Linux EFI"
CONFIG_CDK2_BOOT_TIMEOUT=1
```

## defconfig
```kconfig
CONFIG_CDK2_PAYLOAD=y
CONFIG_CDK2_PCI=y
CONFIG_CDK2_STORAGE=y
CONFIG_CDK2_CONSOLE=y
CONFIG_CDK2_GRAPHICS=y
CONFIG_CDK2_SETUP_UI=y
CONFIG_CDK2_LVGL_RENDERER=n
CONFIG_CDK2_ESRT=y
CONFIG_CDK2_NATIVE_PCD=y
CONFIG_CDK2_NATIVE_DEVICE_PATH=y
CONFIG_CDK2_LATE_LINK=y
CONFIG_CDK2_NATIVE_STAGE=y
CONFIG_CDK2_NATIVE_SECURITY_STUB=y
CONFIG_CDK2_NULL_MEMORY_TEST=y
CONFIG_CDK2_NATIVE_WATCHDOG=y
CONFIG_CDK2_NATIVE_MONOTONIC_COUNTER=y
CONFIG_CDK2_NATIVE_STATUS_CODE_ROUTER=y
CONFIG_CDK2_NATIVE_CPU_IO2=y
CONFIG_CDK2_NATIVE_STATUS_CODE_HANDLER=y
CONFIG_CDK2_NATIVE_DISK_IO=y
CONFIG_CDK2_NATIVE_SERIAL_IO=y
CONFIG_CDK2_SMBIOS_MAJOR=3
CONFIG_CDK2_SMBIOS_MINOR=0
CONFIG_CDK2_SMBIOS_DOCREV=0
CONFIG_CDK2_SMBIOS_ENTRY_POINTS=0x3
CONFIG_CDK2_NATIVE_SMBIOS=y
CONFIG_CDK2_NATIVE_RESET_SYSTEM=y
CONFIG_CDK2_NATIVE_PCAT_RTC=y
CONFIG_CDK2_NATIVE_SMM_ACCESS=y
CONFIG_CDK2_NATIVE_CPU_IO2_SMM=y
CONFIG_CDK2_NATIVE_PCH_SMI_DISPATCH=y
CONFIG_CDK2_BUILD_DEBUG=n
CONFIG_CDK2_SMMSTORE=y
CONFIG_CDK2_EC_ACPI_BATTERY_PROFILE=0
CONFIG_CDK2_SMM=y
CONFIG_CDK2_CAPSULE=n
CONFIG_CDK2_CAPSULE_ON_DISK_SUPPORT=n
CONFIG_CDK2_CAPSULE_ACCEPT_EMBEDDED_DRIVERS=n
CONFIG_CDK2_CAPSULE_EMBED_FMP_DXE=n
CONFIG_CDK2_SECURE_BOOT=n
CONFIG_CDK2_SECURE_BOOT_ASSUME_SETUP_PHYSICAL_PRESENCE=n
CONFIG_CDK2_EVIL_MAID_PROTECTION=n
CONFIG_CDK2_EVIL_MAID_REQUIRE_TPM_PPI=y
CONFIG_CDK2_EVIL_MAID_SHUTDOWN_ON_FAILURE=y
CONFIG_CDK2_SHELL=y
CONFIG_CDK2_NVME=y
CONFIG_CDK2_USB=y
CONFIG_CDK2_ATA=y
CONFIG_CDK2_SD=y
CONFIG_CDK2_PS2_MOUSE=y
CONFIG_CDK2_PS2_KEYBOARD=n
CONFIG_CDK2_SERIAL=n
CONFIG_CDK2_CBMEM_CONSOLE=n
CONFIG_CDK2_CBMEM_TIMESTAMPS=n
CONFIG_CDK2_BOOT_TIMEOUT=0
CONFIG_CDK2_TPM2=y
CONFIG_CDK2_CPU_TIMER=n
CONFIG_CDK2_MAX_LOGICAL_PROCESSORS=1024
```
